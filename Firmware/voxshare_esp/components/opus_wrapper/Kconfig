## Firmware/voxshare_esp/sdkconfig.defaults
```kconfig
# Set IP or leave empty for DHCP
# CONFIG_LWIP_AUTOIP is not set
# CONFIG_LWIP_DHCP_ENABLE=y
CONFIG_ETH_USE_SPI_ETHERNET=y
CONFIG_ETH_SPI_ETHERNET_DM9051=n
CONFIG_ETH_SPI_ETHERNET_W5500=y
```
